## arch/mips/configs/pch_a210_defconfig
```kconfig
CONFIG_ARCH_TANGO=y
CONFIG_TANGOX_CPU=y
CONFIG_DTB_PCH_A210=y
CONFIG_CPU_MIPS32_R2=y
CONFIG_SYS_SUPPORTS_LITTLE_ENDIAN=y
CONFIG_CPU_LITTLE_ENDIAN=y
CONFIG_PRINTK=y
CONFIG_EARLY_PRINTK=y
CONFIG_TANGOX_EARLY_CONSOLE_PORT=0
CONFIG_TANGOX_EARLY_CONSOLE_RATE=115200
CONFIG_SERIAL_8250=y
CONFIG_SERIAL_8250_CONSOLE=y
CONFIG_SERIAL_OF_PLATFORM=y
CONFIG_TANGOX_WATCHDOG=y
CONFIG_NET=y
CONFIG_INET=y
CONFIG_NETDEVICES=y
CONFIG_ETHERNET=y
CONFIG_NET_VENDOR_AURORA=y
CONFIG_AURORA_NB8800=y
CONFIG_PHYLIB=y
CONFIG_FIXED_PHY=y
CONFIG_NETPOLL=y
CONFIG_NETCONSOLE=y
CONFIG_LEDS_CLASS=y
CONFIG_LEDS_GPIO=y
CONFIG_LEDS_TRIGGERS=y
CONFIG_BLK_DEV_INITRD=y
CONFIG_RD_GZIP=y
CONFIG_INITRAMFS_SOURCE=""
CONFIG_BINFMT_ELF=y
CONFIG_BINFMT_MISC=y
CONFIG_CMDLINE_BOOL=y
CONFIG_CMDLINE="console=ttyS0,115200 init=/init"
CONFIG_DEVTMPFS=y
CONFIG_DEVTMPFS_MOUNT=y
CONFIG_PROC_FS=y
CONFIG_SYSFS=y
CONFIG_TMPFS=y
CONFIG_UNIX=y
CONFIG_PACKET=y
CONFIG_ATA=y
CONFIG_SATA_DWC=y
CONFIG_USB_SUPPORT=y
CONFIG_USB=y
CONFIG_USB_EHCI_HCD=y
CONFIG_USB_OHCI_HCD=y
CONFIG_KERNEL_LZO=y
CONFIG_SATA_DWC_TANGO=y
CONFIG_PHY_TANGOX_SATA=y
CONFIG_TANGOX_DMA=y
CONFIG_SCSI=y
CONFIG_BLK_DEV_SD=y
CONFIG_CHR_DEV_SG=y
CONFIG_EXT4_FS=y
CONFIG_EXT4_USE_FOR_EXT2=y
CONFIG_FAT_FS=y
CONFIG_MSDOS_FS=y
CONFIG_VFAT_FS=y
CONFIG_NLS_CODEPAGE_437=y
CONFIG_NLS_ISO8859_1=y
CONFIG_NLS_UTF8=y
CONFIG_DMADEVICES=y
CONFIG_SATA_TANGOX=y
```
